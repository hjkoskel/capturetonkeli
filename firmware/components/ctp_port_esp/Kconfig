## firmware/components/ctp_port_esp/Kconfig
```kconfig
menu "capturetonkeli"

config CTK_SYNTHETIC_TRAFFIC
    bool "Throughput test variant: synthetic frames instead of the radio (M3)"
    default n
    help
        Test-only firmware variant (docs/07 M3). The radio is not started; a
        low-priority task feeds synthetic 802.11 frames into the normal
        capture path (filter, snaplen, ring, link task) as fast as the ring
        accepts them, so `ctpbench bench throughput` measures the USB link.
        caps advertise no 5 GHz. Never enable in release builds.

config CTK_SYNTH_FRAME_LEN
    int "Synthetic frame length incl. header (bytes)"
    depends on CTK_SYNTHETIC_TRAFFIC
    range 24 4096
    default 1500

config CTK_DIAG
    bool "Diagnostics variant: frame-type matrix + callback cycle budget (M4)"
    default n
    help
        Counts the driver's frame type against the 802.11 Frame Control type
        (docs/02 §1 C5 misreport check) and measures the CPU cycles spent in
        ctp_capture_rx (docs/07 §4 rule 10). Reported every 5 s as EVT_LOG.

endmenu
```
